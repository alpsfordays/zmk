## app/boards/shields/g84bean/Kconfig.defconfig
```kconfig
if SHIELD_G84BEAN

config ZMK_KEYBOARD_NAME
    default "G84BEAN"

config BT
    default y

config ZMK_BLE
    default y

endif
```

## app/boards/shields/ricoh/Kconfig.defconfig
```kconfig
if SHIELD_RICOH

config ZMK_KEYBOARD_NAME
    default "ricoh"

config BT
    default y

config ZMK_BLE
    default y

endif
```
